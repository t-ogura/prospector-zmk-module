## Kconfig.advertisement
```kconfig
# Copyright (c) 2024 The ZMK Contributors
# SPDX-License-Identifier: MIT

config ZMK_STATUS_ADVERTISEMENT
    bool "Enable ZMK Status Advertisement"
    default n
    depends on BT
    help
      Enable broadcasting of keyboard status information via BLE Advertisement.
      This allows external devices to receive status updates without establishing
      a connection to the keyboard.

config ZMK_STATUS_ADV_INTERVAL_MS
    int "Status advertisement interval in milliseconds"
    range 100 10000
    default 1000
    depends on ZMK_STATUS_ADVERTISEMENT
    help
      Interval between status advertisement broadcasts in milliseconds.
      Lower values provide more frequent updates but consume more battery.

config ZMK_STATUS_ADV_KEYBOARD_NAME
    string "Keyboard name for status advertisement"
    default "ZMK Keyboard"
    depends on ZMK_STATUS_ADVERTISEMENT
    help
      Name to identify this keyboard in status advertisements.
      Limited to 8 characters including null terminator.
```

## boards/shields/prospector_scanner/Kconfig.defconfig
```kconfig
# Prospector Scanner - Using display_test Kconfig.defconfig for debugging

if SHIELD_PROSPECTOR_SCANNER

config ZMK_KEYBOARD_NAME
    default "Prospect"

config ZMK_DISPLAY
    default y

# MIPI DBI for ST7789V
config MIPI_DBI
    default y

config SPI
    default y

# ST7789V pixel format
choice ST7789V_PIXEL_FORMAT
    default ST7789V_RGB565
endchoice

# LVGL basic settings
config LV_Z_VDB_SIZE
    default 100

config LV_DPI_DEF
    default 261

config LV_Z_BITS_PER_PIXEL
    default 16

choice LV_COLOR_DEPTH
    default LV_COLOR_DEPTH_16
endchoice

config LV_COLOR_16_SWAP
    default y

# Step 3: Use CUSTOM screen (like display_test)
choice ZMK_DISPLAY_STATUS_SCREEN
    default ZMK_DISPLAY_STATUS_SCREEN_CUSTOM
endchoice

endif
```

## boards/shields/prospector_scanner/Kconfig.shield
```kconfig
# Copyright (c) 2024 The ZMK Contributors
# SPDX-License-Identifier: MIT

# MINIMAL BOOT TEST: Match display_test exactly (Trial 20)
# display_test Kconfig.shield has ONLY this line
config SHIELD_PROSPECTOR_SCANNER
    def_bool $(shields_list_contains,prospector_scanner)

# ALL OTHER SETTINGS MOVED TO Kconfig.defconfig OR DISABLED
# Previous settings that caused boot issues:
# - ZMK_BATTERY default y (requires driver initialization)
# - BT_OBSERVER default y
# - ZMK_BLE/USB defaults
# - LVGL default y
```

## boards/shields/scanner_pocket/Kconfig.defconfig
```kconfig
# Copyright (c) 2026 The ZMK Contributors
# SPDX-License-Identifier: MIT

if SHIELD_SCANNER_POCKET

config ZMK_KEYBOARD_NAME
    default "ScanPocket"

# ===== ディスプレイ基本設定 =====
config ZMK_DISPLAY
    default y

config DISPLAY
    default y

config SPI
    default y

# ===== LVGL モノクロ設定 (LS013B7DH05: 144x168, 1bit) =====
config LVGL
    default y

# VDB (Virtual Display Buffer) - 100% full frame
config LV_Z_VDB_SIZE
    default 100

# Disable double buffering to save memory for objects
config LV_Z_DOUBLE_VDB
    default n

# Keep monochrome conversion buffer enabled (default)
# config LV_Z_MONOCHROME_CONVERSION_BUFFER - use default

config LV_DPI_DEF
    default 161

config LV_Z_BITS_PER_PIXEL
    default 1

choice LV_COLOR_DEPTH
    default LV_COLOR_DEPTH_1
endchoice

# Memory pool - need space for widget metadata, styles, rendering buffers
# LVGL uses 8-bit colors internally, converts to 1-bit on flush
# Testing with 128KB to support more objects
config LV_Z_MEM_POOL_SIZE
    default 131072

# ===== LVGL ウィジェット =====
choice ZMK_DISPLAY_STATUS_SCREEN
    default ZMK_DISPLAY_STATUS_SCREEN_CUSTOM
endchoice

config ZMK_DISPLAY_STATUS_SCREEN_CUSTOM
    select LV_USE_LABEL
    select LV_USE_IMG
    select LV_USE_CANVAS
    select LV_USE_BAR

choice ZMK_DISPLAY_WORK_QUEUE
    default ZMK_DISPLAY_WORK_QUEUE_DEDICATED
endchoice

# Increased stack sizes for stable LVGL rendering
config ZMK_DISPLAY_DEDICATED_THREAD_STACK_SIZE
    default 8192

config MAIN_STACK_SIZE
    default 8192

# ===== スキャナー機能 =====
config PROSPECTOR_MODE_SCANNER
    default y

config BT_OBSERVER
    default y

# Scanner Pocket has no touch panel (Memory LCD only)
config PROSPECTOR_TOUCH_ENABLED
    default n

# ===== 省電力設定 =====
# Memory LCD は常時表示でも超低消費電力（60μW）
config ZMK_DISPLAY_BLANK_ON_IDLE
    default n

# ===== Scanner Pocket 固有設定 =====
config SCANNER_POCKET_WIDGET_STATUS
    bool "Scanner Pocket status widget"
    default y
    select LV_USE_LABEL
    select LV_USE_IMG
    help
      Enable the Scanner Pocket status widget for monochrome display.

config SCANNER_POCKET_INVERT_COLORS
    bool "Invert display colors (white text on black background)"
    default y
    help
      When enabled, display uses black background with white text.
      When disabled, display uses white background with black text.

config SCANNER_POCKET_LANDSCAPE
    bool "Use landscape orientation (168x144 instead of 144x168)"
    default y  # Custom rotated driver for landscape
    help
      When enabled, display is rotated 90 degrees for landscape mode.
      Uses custom rotated driver instead of default ls0xx driver.
      Landscape: 168 wide x 144 tall (good for battery bars)
      Portrait: 144 wide x 168 tall

# Disable default ls0xx driver when using rotated driver
config LS0XX
    default n if SCANNER_POCKET_LANDSCAPE

endif # SHIELD_SCANNER_POCKET
```

## boards/shields/scanner_pocket/Kconfig.shield
```kconfig
# Copyright (c) 2026 The ZMK Contributors
# SPDX-License-Identifier: MIT

config SHIELD_SCANNER_POCKET
    def_bool $(shields_list_contains,scanner_pocket)
```

## dts/bindings/behaviors/zmk,behavior-settings-toggle.yaml
```yaml
# Copyright (c) 2024 The ZMK Contributors
# SPDX-License-Identifier: MIT

description: Custom behavior for toggling settings screen

compatible: "zmk,behavior-settings-toggle"

include: zero_param.yaml
```

## test/advertisement_test/config/west.yml
```yaml
manifest:
  remotes:
    - name: zmkfirmware
      url-base: https://github.com/zmkfirmware
    - name: local
      url-base: file:///home/ogu/workspace/prospector
  projects:
    - name: zmk
      remote: zmkfirmware
      revision: main
      import: app/west.yml
    - name: prospector-zmk-module
      remote: local
      revision: feature/scanner-mode
      path: prospector-zmk-module
  self:
    path: config
```

## test/scanner_build_test/config/west.yml
```yaml
manifest:
  remotes:
    - name: zmkfirmware
      url-base: https://github.com/zmkfirmware
  projects:
    - name: zmk
      remote: zmkfirmware
      revision: main
      import: app/west.yml
    - name: prospector-zmk-module
      path: prospector-zmk-module
      url: ../../../
      revision: feature/scanner-mode
  self:
    path: config
```

## zmk-build-v021/config/west.yml
```yaml
manifest:
  remotes:
    - name: zmkfirmware
      url-base: https://github.com/zmkfirmware
    - name: prospector
      url-base: https://github.com/t-ogura
  projects:
    - name: zmk
      remote: zmkfirmware
      revision: v0.2.1
      import: app/west.yml
    - name: prospector-zmk-module
      remote: prospector
      revision: feature/scanner-mode
      path: modules/prospector-zmk-module
  self:
    path: config
```

## zmk-display-test/config/boards/shields/st7789_test/Kconfig.defconfig
```kconfig
if SHIELD_ST7789_TEST

config ZMK_KEYBOARD_NAME
    default "ST7789 Display Test"

config ZMK_DISPLAY
    default y

endif
```

## zmk-minimal-test/config/boards/shields/minimal_test/Kconfig.defconfig
```kconfig
if SHIELD_MINIMAL_TEST

config ZMK_KEYBOARD_NAME
    default "Minimal Test"

endif
```

## zmk-minimal-test/config/boards/shields/prospector_v2/Kconfig.defconfig
```kconfig
if SHIELD_PROSPECTOR_V2

config ZMK_KEYBOARD_NAME
    default "Prospector V2"

config ZMK_DISPLAY
    default y

# MIPI DBI for ST7789V
config MIPI_DBI
    default y

config SPI
    default y

# ST7789V pixel format
choice ST7789V_PIXEL_FORMAT
    default ST7789V_RGB565
endchoice

# LVGL basic settings
config LV_Z_VDB_SIZE
    default 100

config LV_DPI_DEF
    default 261

config LV_Z_BITS_PER_PIXEL
    default 16

choice LV_COLOR_DEPTH
    default LV_COLOR_DEPTH_16
endchoice

config LV_COLOR_16_SWAP
    default y

endif
```

## zmk-simple-test/config/west.yml
```yaml
manifest:
  remotes:
    - name: zmkfirmware
      url-base: https://github.com/zmkfirmware
    - name: caksoylar
      url-base: https://github.com/caksoylar
  projects:
    - name: zmk
      remote: zmkfirmware
      revision: v0.2.1
      import: app/west.yml
    - name: zmk-rgbled-widget
      remote: caksoylar
      revision: main
      path: modules/zmk-rgbled-widget
  self:
    path: config
```

## zmk-stable-test/config/west.yml
```yaml
manifest:
  remotes:
    - name: zmkfirmware
      url-base: https://github.com/zmkfirmware
    - name: prospector-original
      url-base: https://github.com/carrefinho
  projects:
    - name: zmk
      remote: zmkfirmware
      revision: v0.1.0
      import: app/west.yml
    - name: prospector-zmk-module
      remote: prospector-original
      revision: aa0eb94eb65ed3e67a37c4bb39f0784659d69f2f
      path: modules/prospector-zmk-module
  self:
    path: config
```
